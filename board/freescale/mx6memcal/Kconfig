## board/freescale/mx6memcal/Kconfig
```kconfig
if TARGET_MX6MEMCAL

config SYS_BOARD
	default "mx6memcal"

config SYS_VENDOR
	default "freescale"

config SYS_CONFIG_NAME
	default "mx6memcal"

config DDRWIDTH
	int "DDR bus width"
	default 64

config DDRCS
	int "DDR chip selects"
	default 2

choice
	prompt "Memory type"

config	DDR3
	bool "DDR3"
	help
	  Select this if your board design uses DDR3

config	LPDDR2
	bool "LPDDR2"
	help
	  Select this if your board design uses LPDDR2

endchoice

choice
	prompt "Memory type"

config MT41K512M16TNA
	bool "Micron MT41K512M16TNA 512Mx16 (1GiB/chip)"
	depends on DDR3

config MT41K128M16JT
	bool "Micron MT41K128M16JT 128Mx16 (256 MiB/chip)"
	depends on DDR3

config H5TQ4G63AFR
	bool "Hynix H5TQ4G63AFR 512Mx16 (1GiB/chip)"
	depends on DDR3

config H5TQ2G63DFR
	bool "Hynix H5TQ2G63DFR 128Mx16 (256 MiB/chip)"
	depends on DDR3

config MT42L256M32D2LG
	bool "Micron MT42L256M32D2LG LPDDR2 256Mx32 (1GiB/chip)"
	depends on LPDDR2

config MT29PZZZ4D4BKESK
	bool "Micron MT29PZZZ4D4BKESK multi-chip 512MiB LPDDR2/4GiB eMMC"
	depends on LPDDR2

endchoice

config DRAM_DRIVE_STRENGTH
	int "DRAM Drive strength"
	default 6
	range 0 7
	help
		Enter drive strength as an index defined for IOMUX settings
		for GRP_B1DS and others.
		0 == Hi Z
		6 == 40 Ohm (default)
		7 == 34 Ohm
		Value will be applied to all clock and data lines

config RALAT
	int "Read additional latency"
	default 5
	range 0 7
	help
		Enter a latency in number of cycles. This will be added to
		CAS and internal delays for which the MMDC will retrieve the
		read data from the internal FIFO.
		This is used to compensate for board/chip delays.

config WALAT
	int "Write additional latency"
	default 0
	range 0 7
	help
		Enter a latency in number of cycles. This will be added to
		CAS and internal delays for which the MMDC will retrieve the
		read data from the internal FIFO
		This is used to compensate for board/chip delays.

choice
	prompt "Serial console"

config SERIAL_CONSOLE_UART1
	bool "UART1"

config SERIAL_CONSOLE_UART2
	bool "UART2"

endchoice

choice
	prompt "UART pads"

	config UART2_EIM_D26_27
		bool "UART2 on EIM_D26/27 (SabreLite, Nitrogen6x)"
		depends on SERIAL_CONSOLE_UART2

	config UART1_CSI0_DAT10_11
		bool "UART1 on CSI0_DAT10/11 (Wand)"
		depends on SERIAL_CONSOLE_UART1

	config UART1_SD3_DAT6_7
		bool "UART1 on SD3_DAT6/7 (SabreSD)"
		depends on SERIAL_CONSOLE_UART1

	config UART1_UART1
		bool "UART1 on UART1 (i.MX6SL EVK, WaRP)"
		depends on SERIAL_CONSOLE_UART1

endchoice

config IMXIMAGE_OUTPUT
	bool "Include output for imximage"
	default y
	help
		Say "Y" if you want output formatted for use
		in non-SPL builds

endif
```

## board/persistent/mpu5/Kconfig
```kconfig
if TARGET_MPU5

config SYS_BOARD
	default "mpu5"

config SYS_VENDOR
	default "persistent"

config SYS_CONFIG_NAME
	default "mpu5"

endif
```

## board/tr/tr1/Kconfig
```kconfig
if TARGET_TR1

config SYS_BOARD
	default "tr1"

config SYS_VENDOR
	default "tr"

config SYS_CONFIG_NAME
	default "tr1"

endif
```

## configs/mpu5_defconfig
```kconfig
CONFIG_ARM=y
CONFIG_ARCH_MX6=y
CONFIG_TARGET_MPU5=y
CONFIG_SYS_EXTRA_OPTIONS="IMX_CONFIG=board/persistent/mpu5/mpu5.cfg,MX6Q,DDR_MB=2048"
# CONFIG_CMD_IMLS is not set
# CONFIG_CMD_FLASH is not set
# CONFIG_CMD_SETEXPR is not set
CONFIG_DM=y
CONFIG_SPI_FLASH=y
CONFIG_DM_THERMAL=y
```

## configs/mpu5_spl_defconfig
```kconfig
CONFIG_ARM=y
CONFIG_ARCH_MX6=y
CONFIG_TARGET_MPU5=y
CONFIG_SPL=y
CONFIG_SYS_EXTRA_OPTIONS="IMX_CONFIG=board/persistent/mpu5/mpu5.cfg,MX6Q,DDR_MB=2048,SPL"
CONFIG_DM=y
CONFIG_SPI_FLASH=y
CONFIG_DM_THERMAL=y
```

## configs/mx6memcal_defconfig
```kconfig
CONFIG_ARM=y
CONFIG_ARCH_MX6=y
CONFIG_MX6_DDRCAL=y
CONFIG_TARGET_MX6MEMCAL=y
CONFIG_SPL=y
CONFIG_SYS_EXTRA_OPTIONS="IMX_CONFIG=arch/arm/imx-common/spl_sd.cfg,SPL,MX6QDL"
CONFIG_DDRWIDTH=64
CONFIG_DDRCS=2
#CONFIG_MT41K512M16TNA is not set
CONFIG_MT41K128M16JT=y
#CONFIG_H5TQ4G63AFR is not set
```

## configs/mx6memcal_mx6slevk_defconfig
```kconfig
CONFIG_ARM=y
CONFIG_ARCH_MX6=y
CONFIG_TARGET_MX6MEMCAL=y
CONFIG_DDRWIDTH=32
CONFIG_DDRCS=1
CONFIG_LPDDR2=y
CONFIG_RALAT=2
CONFIG_UART1_UART1=y
CONFIG_SPL=y
CONFIG_SYS_EXTRA_OPTIONS="IMX_CONFIG=arch/arm/imx-common/spl_sd.cfg,SPL,MX6SL"
```

## configs/mx6memcal_nitrogen6_max_defconfig
```kconfig
CONFIG_ARM=y
CONFIG_ARCH_MX6=y
CONFIG_MX6_DDRCAL=y
CONFIG_TARGET_MX6MEMCAL=y
CONFIG_SERIAL_CONSOLE_UART2=y
CONFIG_SPL=y
CONFIG_SYS_EXTRA_OPTIONS="IMX_CONFIG=arch/arm/imx-common/spl_sd.cfg,SPL,MX6QDL"
```

## configs/mx6memcal_tr1x_defconfig
```kconfig
CONFIG_ARM=y
CONFIG_ARCH_MX6=y
CONFIG_SPL_LIBCOMMON_SUPPORT=y
CONFIG_SPL_LIBGENERIC_SUPPORT=y
CONFIG_MX6_DDRCAL=y
CONFIG_TARGET_MX6MEMCAL=y
CONFIG_DDRWIDTH=32
CONFIG_DDRCS=1
CONFIG_MT41K128M16JT=y
CONFIG_UART1_UART1=y
CONFIG_SPL_SERIAL_SUPPORT=y
CONFIG_SPL_WATCHDOG_SUPPORT=y
CONFIG_SYS_EXTRA_OPTIONS="IMX_CONFIG=arch/arm/imx-common/spl_sd.cfg,SPL,MX6SL"
CONFIG_SPL=y
CONFIG_HUSH_PARSER=y
# CONFIG_CMD_BOOTD is not set
# CONFIG_CMD_BOOTM is not set
# CONFIG_CMD_ELF is not set
# CONFIG_CMD_IMI is not set
# CONFIG_CMD_IMLS is not set
# CONFIG_CMD_XIMG is not set
# CONFIG_CMD_EXPORTENV is not set
# CONFIG_CMD_IMPORTENV is not set
# CONFIG_CMD_EDITENV is not set
# CONFIG_CMD_SAVEENV is not set
# CONFIG_CMD_ENV_EXISTS is not set
CONFIG_CMD_MEMTEST=y
CONFIG_CMD_MEMINFO=y
# CONFIG_CMD_LOADB is not set
# CONFIG_CMD_LOADS is not set
# CONFIG_CMD_FLASH is not set
# CONFIG_CMD_FPGA is not set
# CONFIG_CMD_NET is not set
# CONFIG_CMD_NFS is not set
CONFIG_CMD_CACHE=y
CONFIG_REGEX=y
```

## configs/mx6memcal_warpboard_defconfig
```kconfig
CONFIG_ARM=y
CONFIG_ARCH_MX6=y
CONFIG_MX6_DDRCAL=y
CONFIG_TARGET_MX6MEMCAL=y
CONFIG_DDRWIDTH=32
CONFIG_DDRCS=1
CONFIG_LPDDR2=y
CONFIG_MT29PZZZ4D4BKESK=y
CONFIG_DRAM_DRIVE_STRENGTH=4
CONFIG_RALAT=2
CONFIG_UART1_UART1=y
CONFIG_SPL=y
CONFIG_SYS_EXTRA_OPTIONS="IMX_CONFIG=arch/arm/imx-common/spl_sd.cfg,SPL,MX6SL"
# CONFIG_CMD_BOOTD is not set
# CONFIG_CMD_BOOTM is not set
# CONFIG_CMD_ELF is not set
# CONFIG_CMD_GO is not set
# CONFIG_CMD_RUN is not set
# CONFIG_CMD_IMI is not set
# CONFIG_CMD_IMLS is not set
# CONFIG_CMD_XIMG is not set
# CONFIG_CMD_EXPORTENV is not set
# CONFIG_CMD_IMPORTENV is not set
# CONFIG_CMD_EDITENV is not set
# CONFIG_CMD_SAVEENV is not set
# CONFIG_CMD_ENV_EXISTS is not set
# CONFIG_CMD_LOADB is not set
# CONFIG_CMD_LOADS is not set
# CONFIG_CMD_FLASH is not set
# CONFIG_CMD_FPGA is not set
# CONFIG_CMD_NET is not set
# CONFIG_CMD_NFS is not set
```

## configs/tr1_defconfig
```kconfig
CONFIG_ARM=y
CONFIG_ARCH_MX6=y
CONFIG_TARGET_TR1=y
CONFIG_SYS_EXTRA_OPTIONS="IMX_CONFIG=board/tr/tr1/imximage.cfg,MX6SL"
# CONFIG_CMD_IMLS is not set
# CONFIG_CMD_FLASH is not set
# CONFIG_CMD_SETEXPR is not set
CONFIG_DM=y
CONFIG_SPI_FLASH=y
CONFIG_DM_THERMAL=y
```
